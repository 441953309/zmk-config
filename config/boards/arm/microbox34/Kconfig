## config/boards/arm/microbox34/Kconfig
```kconfig
#
# Copyright (c) 2022 The ZMK Contributors
# SPDX-License-Identifier: MIT
#

# config BOARD_MICROBOX34_LEFT
#     bool

# config BOARD_MICROBOX34_RIGHT
#     bool

config BOARD_ENABLE_DCDC
    bool "Enable DCDC mode"
    select SOC_DCDC_NRF52X
    default y
    depends on (BOARD_MICROBOX34_LEFT || BOARD_MICROBOX34_RIGHT)

config BOARD_ENABLE_DCDC_HV
    bool "High voltage DCDC converter"
    select SOC_DCDC_NRF52X_HV
    default y
    depends on (BOARD_MICROBOX34_LEFT || BOARD_MICROBOX34_RIGHT)
```

## config/boards/arm/microbox34/Kconfig.board
```kconfig
#
# Copyright (c) 2022 Darryl deHaan
# SPDX-License-Identifier: MIT
#

config BOARD_MICROBOX34_LEFT
    bool "microbox34 left"
    depends on SOC_NRF52840_QIAA


config BOARD_MICROBOX34_RIGHT
    bool "microbox34 right"
    depends on SOC_NRF52840_QIAA
```

## config/boards/arm/microbox34/Kconfig.defconfig
```kconfig
#
# Copyright (c) 2022 Darryl deHaan
# SPDX-License-Identifier: MIT
#

if BOARD_MICROBOX34_LEFT

config ZMK_KEYBOARD_NAME
    default "Microbox34"

config ZMK_SPLIT_ROLE_CENTRAL
    default y

endif # BOARD_MICROBOX34_LEFT


if BOARD_MICROBOX34_LEFT || BOARD_MICROBOX34_RIGHT

config BOARD
    default "microbox34"

config ZMK_SPLIT
    default y

config BT_CTLR
    default BT

if USB

config USB_NRFX
    default y

config USB_DEVICE_STACK
    default y

endif # USB

endif # BOARD_MICROBOX34_LEFT || BOARD_MICROBOX34_RIGHT
```

## config/boards/qoo/microbox34/Kconfig.defconfig
```kconfig
# 左半：主机名 + split central
if BOARD_MICROBOX34_LEFT

config ZMK_KEYBOARD_NAME
	default "Microbox34"

config ZMK_SPLIT_ROLE_CENTRAL
	default y

endif # BOARD_MICROBOX34_LEFT

# 左右半共用：启用分体与 BLE controller
if BOARD_MICROBOX34_LEFT || BOARD_MICROBOX34_RIGHT

config ZMK_SPLIT
	default y

config BT_CTLR
	default BT

endif # BOARD_MICROBOX34_LEFT || BOARD_MICROBOX34_RIGHT
```

## config/boards/qoo/microbox34/Kconfig.microbox34_right
```kconfig
# HWMv2：选择 SoC，并启用 UF2 boot retention
config BOARD_MICROBOX34_RIGHT
	select SOC_NRF52840_QIAA
	select ZMK_BOARD_COMPAT
	imply RETAINED_MEM
	imply RETENTION
	imply RETENTION_BOOT_MODE
```

## config/boards/qoo/microbox34/board.yml
```yaml
boards:
  - name: microbox34_left
    vendor: qoo
    socs:
      - name: nrf52840
        variants:
          - name: zmk
  - name: microbox34_right
    vendor: qoo
    socs:
      - name: nrf52840
        variants:
          - name: zmk
```

## config/boards/qoo/microbox34/microbox34_right_nrf52840_zmk_defconfig
```kconfig
# Enable MPU
CONFIG_ARM_MPU=y

# enable GPIO
CONFIG_GPIO=y

# Enable writing to flash / UF2
CONFIG_USE_DT_CODE_PARTITION=y
CONFIG_BUILD_OUTPUT_UF2=y
CONFIG_MPU_ALLOW_FLASH_WRITE=y
CONFIG_NVS=y
CONFIG_SETTINGS_NVS=y
CONFIG_FLASH=y
CONFIG_FLASH_PAGE_LAYOUT=y
CONFIG_FLASH_MAP=y

# Enable 32kHz crystal
CONFIG_CLOCK_CONTROL_NRF_K32SRC_XTAL=y
CONFIG_CLOCK_CONTROL_NRF_K32SRC_30PPM=y

# 右半仅 BLE peripheral，不开 USB
CONFIG_ZMK_USB=n
CONFIG_ZMK_BLE=y
```

## config/boards/shields/gamebox58/Kconfig.defconfig
```kconfig
if SHIELD_GAMEBOX58_LEFT

config ZMK_KEYBOARD_NAME
	default "Gamebox58"

config ZMK_SPLIT_ROLE_CENTRAL
	default y

endif

if SHIELD_GAMEBOX58_LEFT || SHIELD_GAMEBOX58_RIGHT

config ZMK_SPLIT
	default y

endif
```

## config/boards/shields/gamebox58/Kconfig.shield
```kconfig
config SHIELD_GAMEBOX58_LEFT
    def_bool $(shields_list_contains,gamebox58_left)

config SHIELD_GAMEBOX58_RIGHT
    def_bool $(shields_list_contains,gamebox58_right)
```

## config/west.yml
```yaml
manifest:
  remotes:
    - name: zmkfirmware
      url-base: https://github.com/zmkfirmware
    - name: myzmk
      url-base: https://github.com/441953309
  projects:
    - name: zmk
      remote: zmkfirmware
      revision: main
      import: app/west.yml
  self:
    path: config
```
