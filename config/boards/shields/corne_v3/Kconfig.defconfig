## config/boards/shields/corne_v3/Kconfig.defconfig
```kconfig
if SHIELD_CORNE_V3_LEFT

config ZMK_KEYBOARD_NAME
	default "Corne V3"

config ZMK_SPLIT_ROLE_CENTRAL
	default y

endif

if SHIELD_CORNE_V3_LEFT || SHIELD_CORNE_V3_RIGHT

config ZMK_SPLIT
	default y

endif
```

## config/boards/shields/corne_v3/Kconfig.shield
```kconfig
config SHIELD_CORNE_V3_LEFT
    def_bool $(shields_list_contains,corne_v3_left)

config SHIELD_CORNE_V3_RIGHT
    def_bool $(shields_list_contains,corne_v3_right)
```
