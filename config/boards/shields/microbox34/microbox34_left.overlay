#include "microbox34.dtsi"

&kscan0 {
  input-gpios
    = <&gpio1 10 (GPIO_ACTIVE_LOW | GPIO_PULL_UP)>
    , <&gpio0 13 (GPIO_ACTIVE_LOW | GPIO_PULL_UP)>
    , <&gpio0 22 (GPIO_ACTIVE_LOW | GPIO_PULL_UP)>
    , <&gpio0 8  (GPIO_ACTIVE_LOW | GPIO_PULL_UP)>
    , <&gpio0 6  (GPIO_ACTIVE_LOW | GPIO_PULL_UP)>
    , <&gpio1 13 (GPIO_ACTIVE_LOW | GPIO_PULL_UP)>
    , <&gpio0 15 (GPIO_ACTIVE_LOW | GPIO_PULL_UP)>
    , <&gpio1 14 (GPIO_ACTIVE_LOW | GPIO_PULL_UP)>
    , <&gpio0 21 (GPIO_ACTIVE_LOW | GPIO_PULL_UP)>
    , <&gpio0 11 (GPIO_ACTIVE_LOW | GPIO_PULL_UP)>
    , <&gpio0 2  (GPIO_ACTIVE_LOW | GPIO_PULL_UP)>
    , <&gpio0 20 (GPIO_ACTIVE_LOW | GPIO_PULL_UP)>
    , <&gpio1 12 (GPIO_ACTIVE_LOW | GPIO_PULL_UP)>
    , <&gpio0 19 (GPIO_ACTIVE_LOW | GPIO_PULL_UP)>
    , <&gpio0 12 (GPIO_ACTIVE_LOW | GPIO_PULL_UP)>
    , <&gpio0 23 (GPIO_ACTIVE_LOW | GPIO_PULL_UP)>
    , <&gpio1 9  (GPIO_ACTIVE_LOW | GPIO_PULL_UP)>
    ;
};